## firmware/main/Kconfig.projbuild
```kconfig
menu "sticky-claude"

    config STICKY_CLAUDE_WIFI_SSID
        string "WiFi SSID"
        default ""

    config STICKY_CLAUDE_WIFI_PASSWORD
        string "WiFi password"
        default ""

    config STICKY_CLAUDE_BACKEND_URL
        string "Backend /converse URL (e.g. http://192.168.1.50:8000/converse)"
        default "http://192.168.1.50:8000/converse"

endmenu
```
